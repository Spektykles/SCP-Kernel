## fs/apfs/Kconfig
```kconfig
# SPDX-License-Identifier: GPL-2.0

config APFS_FS
	tristate "APFS filesystem support"
	default y
	select LIBCRC32C
	select NLS
	help
	  This module provides a small degree of experimental support for the
	  Apple File System (APFS).

	  To compile this file system support as a module, choose M here: the
	  module will be called apfs.

	  If you want to use the APFS filesystem, then you must say Y or M here
	  to include APFS support. If unsure, say N.

config APFS_DEBUG
	bool "APFS debugging support"
	default n
	depends on APFS_FS
	help
	  Enable the debugging features for APFS. This may hurt performance,
	  so say N if you are not a developer.
```

## security/dklm/Kconfig
```kconfig
# SPDX-License-Identifier: GPL-2.0
config SECURITY_DKLM
	bool "DKLM security module"
	depends on SECURITY && NET
	select AUDIT
	select SECURITY_PATH
	select SECURITYFS
	select SECURITY_NETWORK
	default n
	help
	  To compile this DKLM choose Y here: the module will be called dklm.

	  If you want to use the DKLM security, then you must say Y here
	  to include DKLM module. If unsure, say N.
```
